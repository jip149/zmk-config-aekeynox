&base_layer {
  display-name = "Base";
  bindings = <SELENIUM_KEYMAP_BINDINGS(
    K_LOUT1 ,  &kp SQT  &kp COMMA &kp DOT &kp P  &kp Y   ,   &kp F  &kp G  &kp C  &kp R  &kp L  ,  K_ROUT1 ,
    K_LOUT2 ,  &H4 A    &H3 O     &H2 E   &H1 U  &kp I   ,   &kp D  &H1 H  &H2 T  &H3 N  &H4 S  ,  K_ROUT2 ,
    K_LOUT3 ,  &kp SEMI &kp Q     &kp J   &kp K  &kp X   ,   &kp B  &kp M  &kp W  &kp V  &kp Z  ,  K_ROUT3 ,
              LTHUMB_TUCK , LTHUMB_HOME , LTHUMB_REACH   ,   RTHUMB_REACH , RTHUMB_HOME , RTHUMB_TUCK
  )>;
};
